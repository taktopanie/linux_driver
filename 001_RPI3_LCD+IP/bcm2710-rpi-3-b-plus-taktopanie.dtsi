#include <dt-bindings/gpio/gpio.h>
#include <dt-bindings/leds/common.h>
/ {
        hd44780 {
                compatible = "hit,hd44780";
                status = "okay";
                pinctrl-names = "default";
                pinctrl-0 = <&my_lcd_gpio>;
                display-height-chars = <2>;
                display-width-chars  = <16>;
                data-gpios = <&gpio 1 0>,
                         <&gpio 7 0>,
                         <&gpio 8 0>,
                         <&gpio 25 0>;
                enable-gpios = <&gpio 16 0>;
                rs-gpios = <&gpio 21 0>;
                rw-gpios = <&gpio 20 0>;
                backlight-gpios = <&gpio 12 0>;
        };
};

&gpio {
        my_lcd_gpio: lcd_gpio {
                brcm,pins = <1 7 8 12 16 20 21 25>;
                brcm,function = <0x01>;
        }; 
};


